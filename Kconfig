## Kconfig
```kconfig
# Copyright (c) 2023-2025 The ZMK Contributors
# SPDX-License-Identifier: MIT

config ZMK_TRACKBALL_PIM447
	bool "PIM447 trackball module driver support"
	depends on ZMK_INPUT
	select I2C
	help
	  Enable support for the Pimoroni PIM447 trackball module driver

source "src/drivers/sensor/trackball_pim447/Kconfig"
source "src/behaviors/behavior_trackball_mode/Kconfig"
```

## dts/bindings/behaviors/zmk,behavior-trackball-mode.yaml
```yaml
# Copyright (c) 2023-2025 The ZMK Contributors
# SPDX-License-Identifier: MIT

description: Trackball mode behavior

compatible: "zmk,behavior-trackball-mode"

#include: zmk,behavior-base.yaml

properties:
  label:
    type: string
    description: Human-readable name for the behavior
  "#binding-cells":
    type: int
    const: 1
  default-mode:
    type: int  # Changed from string to int
    enum:
      - 0  # 0 = move
      - 1  # 1 = scroll
    default: 0 # Default to move mode
    description: Default mode (0=move, 1=scroll)
  led-mode-move:
    type: int
    default: 2 # Corresponds to LED_GREEN in trackball_pim447.h
    description: LED color preset for move mode (see include/dt-bindings/zmk/trackball_pim447.h)
  led-mode-scroll:
    type: int
    default: 3 # Corresponds to LED_BLUE in trackball_pim447.h
    description: LED color preset for scroll mode (see include/dt-bindings/zmk/trackball_pim447.h)
```

## dts/bindings/sensor/pimoroni,trackball_pim447.yaml
```yaml
# Copyright (c) 2023-2025 The ZMK Contributors
# SPDX-License-Identifier: MIT

description: Pimoroni Trackball (PIM447) I2C sensor
compatible: "pimoroni,trackball_pim447"

include: i2c-device.yaml

properties:
  reg:
    type: int
    required: true
    description: I2C device address (0x0A)
  
  sensitivity:
    type: int
    default: 64
    description: Trackball sensitivity (1-255)
    min: 1
    max: 255

  move-factor:
    type: int
    default: 1
    description: Movement factor scaling (higher values = faster movement)
    min: 1
    max: 10

  scroll-factor:
    type: int
    default: 1
    description: Scroll factor scaling (higher values = faster scrolling)
    min: 1
    max: 10

  led-red:
    type: int
    default: 0
    description: Red component of LED color (0-255)
    min: 0
    max: 255

  led-green:
    type: int
    default: 0
    description: Green component of LED color (0-255)
    min: 0
    max: 255

  led-blue:
    type: int
    default: 0
    description: Blue component of LED color (0-255)
    min: 0
    max: 255

  invert-x:
    type: boolean
    description: Invert X-axis direction

  invert-y:
    type: boolean
    description: Invert Y-axis direction
```

## dts/bindings/zmk/behaviors/zmk,behavior-trackball-mode.yaml
```yaml
# Copyright (c) 2023-2025 The ZMK Contributors
# SPDX-License-Identifier: MIT

description: Trackball mode behavior

compatible: "zmk,behavior-trackball-mode"

include: zmk,behavior-base.yaml

properties:
  label:
    type: string
    description: Human-readable name for the behavior
  "#binding-cells":
    type: int
    const: 1
  default-mode:
    type: string
    enum:
      - "move"
      - "scroll"
    default: "move"
    description: Default mode (move or scroll)
  led-mode-move:
    type: int
    default: 2
    description: LED color for move mode (0=off, 1=red, 2=green, 3=blue, 4=yellow, 5=cyan, 6=magenta, 7=white)
  led-mode-scroll:
    type: int
    default: 3
    description: LED color for scroll mode (0=off, 1=red, 2=green, 3=blue, 4=yellow, 5=cyan, 6=magenta, 7=white)
```

## src/behaviors/behavior_trackball_mode/Kconfig
```kconfig
# Copyright (c) 2023-2025 The ZMK Contributors
# SPDX-License-Identifier: MIT

config ZMK_BEHAVIOR_TRACKBALL_MODE
    bool "Trackball Mode Behavior"
    default y
    depends on ZMK_BEHAVIORS && ZMK_TRACKBALL_PIM447
    help
      Enable the trackball mode behavior, allowing switching between
      mouse movement and scrolling using the trackball.

if ZMK_BEHAVIOR_TRACKBALL_MODE

config ZMK_BEHAVIOR_TRACKBALL_MODE_DEBUG
    bool "Debug logs for Trackball Mode Behavior"
    default n
    depends on ZMK_LOGGING
    help
      Enable debug logging for the trackball mode behavior.

endif # ZMK_BEHAVIOR_TRACKBALL_MODE
```

## src/drivers/sensor/trackball_pim447/Kconfig
```kconfig
# Copyright (c) 2023-2025 The ZMK Contributors
# SPDX-License-Identifier: MIT

# Note: The main ZMK_TRACKBALL_PIM447 config is defined in the root Kconfig
# This file should only contain options *dependent* on the main config.

if ZMK_TRACKBALL_PIM447

config ZMK_TRACKBALL_PIM447_DEBUG
    bool "Debug logs for Pimoroni PIM447 trackball"
    default n
    depends on ZMK_LOGGING # Add dependency on logging subsystem
    help
      Enable debug logging for the Pimoroni trackball driver.

# Behavior config moved to its own Kconfig file

endif # ZMK_TRACKBALL_PIM447
```
